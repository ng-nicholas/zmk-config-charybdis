## config/west.yml
```yaml
manifest:
  remotes:
  - name: zmkfirmware
    url-base: https://github.com/zmkfirmware
  - name: badjeff
    url-base: https://github.com/badjeff
  # - name: carrefinho
  #   url-base: https://github.com/carrefinho
  - name: englmaxi
    url-base: https://github.com/englmaxi
  - name: bwshockley
    url-base: https://github.com/bwshockley
  - name: tokyo2006
    url-base: https://github.com/tokyo2006
    
  projects:
  - name: zmk
    remote: zmkfirmware
    revision: v0.3-branch
    import: app/west.yml
  - name: zmk-pmw3610-driver
    remote: badjeff
    revision: zmk-0.3
  # - name: prospector-zmk-module
  #   remote: carrefinho
  #   revision: main
  - name: prospector-zmk-module                 # <--- and these
    remote: tokyo2006                          # <---
    revision: micro_spi2  
  - name: zmk-dongle-display
    remote: englmaxi
    revision: c6c4be11c5ede722086a2a1f355cec9c101b9390
  - name: zmk-dongle-screen
    remote: bwshockley
    revision: main
  self:
    path: config
```
