#include "dongle_nice_common.dtsi"

/ {
	chosen {
		zephyr,display = &oled;
	};
};

// I2C for OLED on nice!nano
&i2c0 {
	oled: sh1106@3c {
        compatible = "sinowealth,sh1106";
        reg = <0x3c>;
        width = <129>;
        height = <64>;
        segment-offset = <1>;
        page-offset = <0>;
        display-offset = <0>;
        multiplex-ratio = <63>;
        segment-remap;
        com-invdir;
        inversion-on;
        prechargep = <0x22>;
	};
};
